## CMakeLists.txt
```
cmake_minimum_required(VERSION 3.20.0)

find_package(Zephyr)
project(zephyr_nativesim_app)

target_sources(app PRIVATE src/main.c)
```

## prj.conf
```kconfig
# Minimal config
CONFIG_CONSOLE=y
CONFIG_PRINTK=y
CONFIG_GPIO=y
CONFIG_GPIO_EMUL=y
#CONFIG_KERNEL_SHELL=y
#CONFIG_SHELL=y
```

## src/main.c
```c
#include <zephyr/kernel.h>
#include <zephyr/sys/printk.h>

void main(void)
{
    printk("Hello World! %s\n", CONFIG_BOARD);
}
```
